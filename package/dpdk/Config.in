## package/dpdk/Config.in
```kconfig
config BR2_PACKAGE_DPDK_ARCH_SUPPORTS
	bool
	depends on BR2_TOOLCHAIN_HAS_SYNC_1
	depends on BR2_TOOLCHAIN_HAS_SYNC_2
	depends on BR2_TOOLCHAIN_HAS_SYNC_4
	depends on BR2_TOOLCHAIN_HAS_SYNC_8
	default y if (BR2_i386 && !BR2_x86_i386 && !BR2_x86_i486 \
		&& !BR2_x86_i586 && !BR2_x86_x1000)
	default y if BR2_x86_64
	default y if BR2_aarch64 || BR2_aarch64_be
	default y if BR2_ARM_CPU_ARMV7A
	default y if BR2_powerpc64
	#default y if BR2_powerpc || BR2_powerpc64 || BR2_powerpc64le

comment "dpdk needs a glibc toolchain and a Linux Kernel to be built"
	depends on BR2_PACKAGE_DPDK_ARCH_SUPPORTS
	depends on !BR2_TOOLCHAIN_USES_GLIBC || !BR2_LINUX_KERNEL

menuconfig BR2_PACKAGE_DPDK
	bool "dpdk"
	depends on BR2_PACKAGE_DPDK_ARCH_SUPPORTS
	depends on BR2_TOOLCHAIN_USES_GLIBC
	depends on BR2_LINUX_KERNEL
	select BR2_LINUX_NEEDS_MODULES
	#select BR2_PACKAGE_LIBPCAP
	#select BR2_PACKAGE_NUMACTL
	help
	  DPDK is a set of libraries and drivers for fast packet
	  processing. It was designed to run on any processors,
	  however, Intel x86 has been the first CPU to be supported.
	  Ports for other CPUs like IBM Power 8 and ARM are under
	  progress. It runs mostly in Linux userland. A FreeBSD port
	  is now available for a subset of DPDK features.

	  Notes:
	  * To build the included Linux kernel drivers, it is necessary
	    to enable CONFIG_PCI_MSI, CONFIG_UIO.
	  * To use hugepages (which is requred by DPDK), the Linux kernel
	    configuration CONFIG_HUGETLBFS needs to be enabled.
	  * To build the PCAP PMD, you need to enable the
	    libpcap manually.
	  * Python version 2.7+ or 3.2+ is required to use the various
	    helper scripts included in the DPDK package
	    (usertools/*.py).

	  http://www.dpdk.org/

if BR2_PACKAGE_DPDK

config BR2_PACKAGE_DPDK_DOCS
	bool "build documentation"
	select BR2_PACKAGE_PYTHON3
	select BR2_PACKAGE_PYTHON_SPHINX
	select BR2_PACKAGE_DOXYGEN
	help
	  build and install dpdk api documentation and guides.

config BR2_PACKAGE_DPDK_KMODS
	bool "build kernel modules"
	#depend on BR2_PACKAGE_KMOD
	help
	  build the included kernel modules.

config BR2_PACKAGE_DPDK_TESTS
	bool "Install tests suite"
	select BR2_PACKAGE_PYTHON_PEXPECT if BR2_PACKAGE_PYTHON ||\
		BR2_PACKAGE_PYTHON3
	help
	  Install all DPDK tests. Note that Python is required
	  to run the included autotest.py script.

config BR2_PACKAGE_DPDK_EXAMPLES
	bool "Enable examples"
	help
	  build and install the example applications

endif
```

## package/python-snowballstemmer/Config.in
```kconfig
config BR2_PACKAGE_PYTHON_SNOWBALLSTEMMER
	bool "python-snowballstemmer"
	help
	  This package provides 23 stemmers for 22 languages
	  generated from Snowball algorithms.

	  https://github.com/snowballstem/snowball
```

## package/python-sphinx/Config.in
```kconfig
config BR2_PACKAGE_PYTHON_SPHINX
	bool "python-sphinx"
	select BR2_PACKAGE_PYTHON_SPHINXCONTRIB_APPLEHELP # runtime
	select BR2_PACKAGE_PYTHON_SPHINXCONTRIB_DEVHELP # runtime
	select BR2_PACKAGE_PYTHON_SPHINXCONTRIB_JSMATH # runtime
	select BR2_PACKAGE_PYTHON_SPHINXCONTRIB_HTMLHELP # runtime
	select BR2_PACKAGE_PYTHON_SPHINXCONTRIB_SERIALIZINGHTML # runtime
	select BR2_PACKAGE_PYTHON_SPHINXCONTRIB_QTHELP # runtime
	select BR2_PACKAGE_PYTHON_JINJA2 # runtime
	select BR2_PACKAGE_PYTHON_PYGMENTS # runtime
	select BR2_PACKAGE_PYTHON_DOCUTILS # runtime
	select BR2_PACKAGE_PYTHON_SNOWBALLSTEMMER # runtime
	select BR2_PACKAGE_PYTHON_BABEL # runtime
	select BR2_PACKAGE_PYTHON_ALABASTER # runtime
	select BR2_PACKAGE_PYTHON_IMAGESIZE # runtime
	select BR2_PACKAGE_PYTHON_REQUESTS # runtime
	select BR2_PACKAGE_PYTHON_SETUPTOOLS # runtime
	select BR2_PACKAGE_PYTHON_PACKAGING # runtime
	help
	  Python documentation generator.

	  http://sphinx-doc.org/
```

## package/python-sphinxcontrib-applehelp/Config.in
```kconfig
config BR2_PACKAGE_PYTHON_SPHINXCONTRIB_APPLEHELP
	bool "python-sphinxcontrib-applehelp"
	help
	  A sphinx extension which outputs Apple help books.

	  http://sphinx-doc.org/
```

## package/python-sphinxcontrib-devhelp/Config.in
```kconfig
config BR2_PACKAGE_PYTHON_SPHINXCONTRIB_DEVHELP
	bool "python-sphinxcontrib-devhelp"
	help
	  A sphinx extension which outputs Devhelp documents.

	  http://sphinx-doc.org/
```

## package/python-sphinxcontrib-htmlhelp/Config.in
```kconfig
config BR2_PACKAGE_PYTHON_SPHINXCONTRIB_HTMLHELP
	bool "python-sphinxcontrib-htmlhelp"
	help
	  A sphinx extension which renders HTML help files.

	  http://sphinx-doc.org/
```

## package/python-sphinxcontrib-jsmath/Config.in
```kconfig
config BR2_PACKAGE_PYTHON_SPHINXCONTRIB_JSMATH
	bool "python-sphinxcontrib-jsmath"
	help
	  A sphinx extension which renders display math in HTML via
	  JavaScript.

	  http://sphinx-doc.org/
```

## package/python-sphinxcontrib-qthelp/Config.in
```kconfig
config BR2_PACKAGE_PYTHON_SPHINXCONTRIB_QTHELP
	bool "python-sphinxcontrib-qthelp"
	help
	  A sphinx extension which outputs QtHelp documents.

	  http://sphinx-doc.org/
```

## package/python-sphinxcontrib-serializinghtml/Config.in
```kconfig
config BR2_PACKAGE_PYTHON_SPHINXCONTRIB_SERIALIZINGHTML
	bool "python-sphinxcontrib-serializinghtml"
	help
	  a sphinx extension which outputs "serialized"
	  HTML files (json and pickle).

	  http://sphinx-doc.org/
```
